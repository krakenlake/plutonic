ENTRY (start);

MEMORY{
  BOOTRAM (rw): ORIGIN = BOOTRAM_START, LENGTH = 512M
}

SECTIONS{

  . = BOOTRAM_START;

  .text :{
    _stext = .;
    *(.init);
    . = ALIGN(8);
    *(.text .text*);
    . = ALIGN(8);
    _etext = .;
  }

	.rodata : {
    . = ALIGN(8);
    _srodata = .;
    *(.rodata .rodata*);
		. = ALIGN(8);
		_erodata = .;
	}

	.data : {
    . = ALIGN(8);
    _sdata = .;
    *(.data .data.*);
		. = ALIGN(8);
		_edata = .;
	}

  .bss (NOLOAD) :{
    . = ALIGN(8);
    _sbss = .;
    *(.bss*);
    . = ALIGN(8);
    _ebss = .;
  }

  . = ALIGN(8);
  _estack = . + 2M;
}


